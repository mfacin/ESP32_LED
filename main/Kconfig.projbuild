## main/Kconfig.projbuild
```kconfig
menu "Wi-Fi SSID and password"
    config WIFI_SSID
        string "Wi-Fi SSID"
        default "WIFI_SSID"
        help
            Wi-Fi SSID.

    config WIFI_PASSWD
        string "Wi-Fi password"
        default "WIFI_PASSWD"
        help
            Wi-Fi password.
    
    config GPIO_LED_RED
        int "Red LED GPIO number"
        default 16
        help
            GPIO number associated with red LED.
    
    config GPIO_LED_GREEN
        int "Green LED GPIO number"
        default 18
        help
            GPIO number associated with green LED.
    
    config GPIO_LED_BLUE
        int "Blue LED GPIO number"
        default 21
        help
            GPIO number associated with blue LED.
endmenu
```
